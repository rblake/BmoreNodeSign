
#define ARDUINO_ID 0

#define LIGHTS_PER_STRING 24

#define BYTES_PER_OUTPUT 6
#define BITS_PER_COLOR 12
#define BYTES_PER_FRAME (BITS_PER_COLOR*BYTES_PER_OUTPUT)


//FIXME!  Write zero to all the registers
#define SAY_LOW do {                            \
PORTA = 0x00;                                   \
PORTB = 0x00;                                   \
PORTC = 0x00;                                   \
PORTE = 0x00;                                   \
PORTF = 0x00;                                   \
PORTG = 0x00;                                   \
} while(0)

//FIXME! Write one to all the registers
#define SAY_HIGH do {                           \
PORTA = 0xFF;                                   \
PORTB = 0xFF;                                   \
PORTC = 0xFF;                                   \
PORTE = 0xFF;                                   \
PORTF = 0xFF;                                   \
PORTG = 0xFF;                                   \
} while(0)

//FIXME: write out 6 bytes to all the registers, based off of the pin
//mapping.
#define SAY_VAR do {                           \
PORTA = 0xFF;                                   \
PORTB = 0xFF;                                   \
PORTC = 0xFF;                                   \
PORTE = 0xFF;                                   \
PORTF = 0xFF;                                   \
PORTG = 0xFF;                                   \
} while(0)

byte displayA[BYTES_PER_FRAME*LIGHTS_PER_STRING] =
"\xfe\xff\xff\xfe\xff\xff\xfe\xff\xff\xfe\xff\xff\xfe\xff\xff\xfe\xff\xff\xfe\xff\xff\xfe\xff\xff"
"\xfe\xff\xff\xfe\xff\xff\xfe\xff\xff\xfe\xff\xff\xfe\xff\xff\xfe\xff\xff\xfe\xff\xff\xfe\xff\xff"
"\xfe\xff\xff\xfe\xff\xff\xfe\xff\xff\xfe\xff\xff\xfe\xff\xff\xfe\xff\xff\xfe\xff\xff\xfe\xff\xff"
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"\xff\xff\x1f\xff\xff\xff\xff\xff\x1f\xff\xff\xff\xff\xff\x1f\xff\xff\xff\xff\xff\x1f\xff\xff\xff"
;

byte displayB[BYTES_PER_FRAME*LIGHTS_PER_STRING];

byte* currentDisplay = &displayA;
byte* nextDisplay = &displayB;


#define STATIC_ASSERT(test, name) byte assert##name[!(test)]

/* Three ticks per bite, plus one tick to start, plus a rest of at least 3 ticks)
 */
#define NUMBITS (6+8+12)
#define INTERRUPT_MAX (1+NUMBITS*3+3)
#define WAIT_FOR_FRAME (INTERRUPT_MAX+1)

byte addr;
byte intensity=0xCC;
byte* outputBuffer;
int iterCount=WAIT_FOR_FRAME;
void allLightsInterrupt() {
  static int iterCount=0;
  
  //Trigger that we're sending now.
  if (iterCount == 0) {
    SAY_HIGH();
  } else if (iterCount <= INTERRUPT_MAX) {
    switch (iterCount % 3) {
    case 1:
      SAY_LOW();
      break;
    default:
      int bit = (iterCount-2)/3;
      switch (bit) {
      case  0: if (addr & B100000) {SAY_LOW;} else {SAY_HIGH;} break;
      case  1: if (addr & B010000) {SAY_LOW;} else {SAY_HIGH;} break;
      case  2: if (addr & B001000) {SAY_LOW;} else {SAY_HIGH;} break;
      case  3: if (addr & B000100) {SAY_LOW;} else {SAY_HIGH;} break;
      case  4: if (addr & B000010) {SAY_LOW;} else {SAY_HIGH;} break;
      case  5: if (addr & B000001) {SAY_LOW;} else {SAY_HIGH;} break;
      case  6: if (intensity & B10000000) {SAY_LOW;} else {SAY_HIGH;} break;
      case  7: if (intensity & B01000000) {SAY_LOW;} else {SAY_HIGH;} break;
      case  8: if (intensity & B00100000) {SAY_LOW;} else {SAY_HIGH;} break;
      case  9: if (intensity & B00010000) {SAY_LOW;} else {SAY_HIGH;} break;
      case 10: if (intensity & B00001000) {SAY_LOW;} else {SAY_HIGH;} break;
      case 11: if (intensity & B00000100) {SAY_LOW;} else {SAY_HIGH;} break;
      case 12: if (intensity & B00000010) {SAY_LOW;} else {SAY_HIGH;} break;
      case 13: if (intensity & B00000001) {SAY_LOW;} else {SAY_HIGH;} break;
      default:
        SAY_VAR(outBuffer);
        outBuffer += BYTES_PER_OUTPUT;
        break;
      }
    case 0:
      SAY_HIGH();
      break;
    }
  } else {
    SAY_LOW();
  }

  if (iterCount == INTERRUPT_MAX) {
    if (addr < LIGHTS_PER_STRING) {
      addr++;
      iterCount=0;
    } else {
      iterCount=WAIT_FOR_FRAME;
    }
  } else {
    iterCount++;
  }
}

void renderFrame() {
  while (iterCount != WAIT_FOR_FRAME) {}
  outputBuffer = currentDisplay;
  addr=0;
  iterCount=0;
}

void setup() 
{
  Serial.println(ARDUINO_ID);
  //FIXME set up the interrupt routine here.
  
}

void loop()
{
  do {
    renderFrame();
    const bool do_read = false;
    if (do_read) {
      Serial.println("OK");
      //search for an "OK"
      bool found_ok = false;
      while (!found_ok) {
        while (Serial.available() < 2) {}
        byte O = Serial.read();
        if (O == 'O') {
          byte K = Serial.read();
          if (K == 'K') {
            found_ok = true;
          }
        }
      }
      for (int ii=0; ii<LIGHTS_PER_STRING; ii++) {
        for (int jj=0; jj<BYTES_PER_FRAME; jj++) {
          while (Serial.available() < 1) {}
          nextDisplay[ii*BYTES_PER_FRAME+jj]=Serial.read();
        }
      }
      swap(currentDisplay,nextDisplay);
    }
  } while (1);
}
